## app/boards/de_cero/board.yml
```yaml
board:
  name: de_cero
  full_name: LA-NUCLEO (copia de F411RE, pero ahora desde cero)
  vendor: idlechara
  socs:
    - name: stm32f411xe
```

## app/boards/de_cero/de_cero_defconfig
```kconfig
# Required by the original board
CONFIG_ARM_MPU=y
CONFIG_HW_STACK_PROTECTION=y

# we need these for console
CONFIG_SERIAL=y
CONFIG_CONSOLE=y
CONFIG_UART_CONSOLE=y

# It took me solid 4 hours to figure this out.
```

## app/boards/la_nucleo/Kconfig.defconfig
```kconfig
# LA-NUCLEO board configuration

# Copyright (c) 2016 Matthias Boesl
# SPDX-License-Identifier: Apache-2.0

if BOARD_LA_NUCLEO

config SPI_STM32_INTERRUPT
	default y
	depends on SPI

endif # BOARD_LA_NUCLEO
```

## app/boards/la_nucleo/Kconfig.la_nucleo
```kconfig
# Copyright (c) 2016 Matthias Boesl
# SPDX-License-Identifier: Apache-2.0

config BOARD_LA_NUCLEO
	select SOC_STM32F411XE
```

## app/boards/la_nucleo/board.yml
```yaml
board:
  name: la_nucleo
  full_name: LA-NUCLEO (copia de F411RE)
  vendor: idlechara
  socs:
    - name: stm32f411xe
```

## app/drivers/subsys/our_driver/Kconfig
```kconfig
menuconfig IDLECHARA_SENSOR
    bool "Enable idlechara's sensor driver"
    select SENSOR
    depends on DT_HAS_IDLECHARA_SENSOR_ENABLED
    help
      THE BEST DRIVER THAT's EVER EXISTED @__@
```

## west.yml
```yaml
manifest:
  version: 1.0

  projects:
    - name: zephyr
      url: https://github.com/zephyrproject-rtos/zephyr
      revision: v4.2.0
      import:
        name-allowlist:
          - cmsis_6
          - hal_nxp
          - hal_stm32
          - hal_nordic
        # sadly, this entry needs to be relative to the workspace dir. For the case of this 
        # devcontainer it is /workspaces, thus /workspaces/deps is the place on which the dependencies are stored
        path-prefix: deps
```
